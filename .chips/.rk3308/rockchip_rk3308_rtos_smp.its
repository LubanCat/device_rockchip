## .chips/.rk3308/rockchip_rk3308_rtos_smp.its
```
/* SPDX-License-Identifier: BSD-3-Clause */
/*
 * Copyright (c) 2023 Rockchip Electronics Co., Ltd.
 */

/dts-v1/;
/ {
	description = "FIT source file for rockchip AMP";
	#address-cells = <1>;

	images {

		amp0 {
			description  = "bare-mental-core0";
			data         = /incbin/("cpu0.bin");
			type         = "firmware";
			compression  = "none";
			arch         = "arm";	 // "arm64" or "arm"
			sys          = "rtt";
			cpu          = <0x000>;  // mpidr
			thumb        = <0>;      // 0: arm or thumb2; 1: thumb
			hyp          = <0>;      // 0: el1/svc; 1: el2/hyp
			load         = <0x00800000>;
			size         = <0x02700000>;
			srambase     = <0xfff88000>;
			sramsize     = <0x00038000>;
			udelay       = <10000>;
			hash {
				algo = "sha256";
			};
		};

	};

	share_memory {
		base         = <0x02f00000>;
		size         = <0x00100000>;
	};

	configurations {
		default = "conf";
		conf {
			description = "Rockchip AMP images";
			rollback-index = <0x0>;
			loadables = "amp0";
			primary = <0x0>;

			signature {
				algo = "sha256,rsa2048";
				padding = "pss";
				key-name-hint = "dev";
				sign-images = "loadables";
			};
		};
	};
};
```

## .chips/rk3308/rockchip_rk3308_rtos_linux.its
```
/* SPDX-License-Identifier: BSD-3-Clause */
/*
 * Copyright (c) 2022 Rockchip Electronics Co., Ltd.
 */

/dts-v1/;
/ {
	description = "FIT source file for rockchip AMP";
	#address-cells = <1>;

	images {
		amp3 {
			description  = "bare-mental-core3";
			data         = /incbin/("cpu3.bin");
			type         = "firmware";
			compression  = "none";
			arch         = "arm";
			sys          = "rtt";
			cpu          = <0x3>;
			thumb        = <0>;
			hyp          = <0>;
			load         = <0x02e00000>;
			size         = <0x00400000>;
			srambase     = <0xfffa0000>;
			sramsize     = <0x00010000>;
			udelay       = <10000>;
			hash {
				algo = "sha256";
			};
		};
	};

	share_memory {
		base         = <0x03200000>;
		size         = <0x00100000>;
	};

	configurations {
		default = "conf";
		conf {
			description = "Rockchip AMP images";
			rollback-index = <0x0>;
			loadables = "amp3";
			primary = <0x0>;

			signature {
				algo = "sha256,rsa2048";
				padding = "pss";
				key-name-hint = "dev";
				sign-images = "loadables";
			};

			/* - run linux on cpu0
			 * - it is brought up by amp(that run on U-Boot)
			 * - it is boot entry depends on U-Boot
			 */
			linux {
				description  = "linux-os";
				arch         = "arm64";
				cpu          = <0x0>;
				thumb        = <0>;
				hyp          = <0>;
				udelay       = <0>;
			};
		};
	};
};
```
